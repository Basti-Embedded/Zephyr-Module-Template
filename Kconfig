## drivers/Kconfig
```kconfig
# @file    Kconfig
# @brief   Kconfig entry file for Drivers

menu "Custom Drivers"

rsource "template_driver/Kconfig"

endmenu
```

## drivers/template/Kconfig
```kconfig
# *******************************************************************************
# @file     Kconfig
# @brief    add all device driver specific Kconfigs here 
# @SPDX-License-Identifier: Apache-2.0
# *******************************************************************************

rsource "Kconfig.Template"
```

## drivers/template_driver/Kconfig
```kconfig
# @file    Kconfig
# @brief   Kconfig file for a Zephyr Driver

menuconfig TEMPLATE_DRIVER
	bool "Enable Template Driver"

if TEMPLARE_DRIVER

module = TEMPLATE_DRIVER
module-str = "TEMPLATE_DRIVER"
source "subsys/logging/Kconfig.template.log_config"

config TEMPLATE_DRIVER_INIT_PRIORITY
	int "template driver init priority"
	default 90
	help
	  template driver initialization priority.

endif # TEMPLATE_DRIVER
```

## dts/bindings/zephyr_example_module/zephyr,template.yaml
```yaml
# @file    .yaml
# @brief   device tree binding

description: Devicetree Bindings for Zephyr Example Module

compatible: "zephyr,zephyr-example-module"

include:
  - base.yaml
  - uart-device.yaml
  - i2c-device.yaml

properties:

  # only for I2C
  reg:
    description: "I2C address of the connected Device"
    required: true

  template-gpios:
    type: phandle-array
    required: false
    description: Template GPIO pins for the Zephyr Example Module.

  template-int:
    type: int
    required: false
    description: Template Text
    enum:
      - 0
      - 1
      - 2
      - 3
```
